## boards/arm/szfpga_gw1nsr4c/Kconfig.board
```kconfig
# Copyright (c) 2023 YuLong Yao <feilongphone@gmail.com>
# SPDX-License-Identifier: Apache-2.0

config BOARD_SZFPGA_GW1NSR4C
	bool "Gowin EMPU on SZFPGA GW1NSR4C"
	depends on SOC_GWEMPU
```

## boards/arm/szfpga_gw1nsr4c/Kconfig.defconfig
```kconfig
# Copyright (c) 2023 YuLong Yao <feilongphone@gmail.com>
# SPDX-License-Identifier: Apache-2.0

if BOARD_SZFPGA_GW1NSR4C

config BOARD
	default "gowin_szfpga_gw1nsr4k"

endif # BOARD_SZFPGA_GW1NSR4C
```

## boards/arm/tangnano4k/Kconfig.board
```kconfig
# Copyright (c) 2023 YuLong Yao <feilongphone@gmail.com>
# SPDX-License-Identifier: Apache-2.0

config BOARD_TANGNANO4K
	bool "Gowin EMPU on TANGNANO4K"
	depends on SOC_GWEMPU
```

## boards/arm/tangnano4k/Kconfig.defconfig
```kconfig
# Copyright (c) 2023 YuLong Yao <feilongphone@gmail.com>
# SPDX-License-Identifier: Apache-2.0

if BOARD_TANGNANO4K

config BOARD
	default "gowin_tangnano4k"

endif # BOARD_TANGNANO4K
```

## drivers/Kconfig
```kconfig
# Copyright (c) 2023 YuLong Yao <feilongphone@gmail.com>
# SPDX-License-Identifier: Apache-2.0

menu "out-tree drivers"

rsource "gpio/Kconfig"

endmenu
```

## drivers/gpio/Kconfig.gowin_empu_gpio
```kconfig
# Copyright (c) 2023 YuLong Yao <feilongphone@gmail.com>
# SPDX-License-Identifier: Apache-2.0

config GPIO_GOWIN_EMPU
	bool "Support for the demonstration out of tree driver"
```

## dts/bindings/gowin,empu_gpio.yaml
```yaml
description: GOWIN EMPU GPIO

compatible: "gowin,empu_gpio"

include: [gpio-controller.yaml, base.yaml]

properties:
  reg:
    required: true

gpio-cells:
  - pin
  - flags
```

## dts/bindings/serial/gowin,empu_uart.yaml
```yaml
description: GOWIN EMPU uart

compatible: "gowin,empu_uart"

include: uart-controller.yaml

properties:
  reg:
    required: true
```

## samples/basic/blinky/Kconfig
```kconfig
# General configuration options

# Copyright (c) 2023 YuLong Yao <feilongphone@gmail.com>
# SPDX-License-Identifier: Apache-2.0

mainmenu "Chisel MCU"

menu "Zephyr Kernel Configuration"
source "Kconfig.zephyr"
endmenu
```

## soc/arm/gowin/Kconfig
```kconfig
#
# Copyright (c) 2023 YuLong Yao <feilongphone@gmail.com>
# SPDX-License-Identifier: Apache-2.0
#

config SOC_FAMILY_GOWIN
	bool

if SOC_FAMILY_GOWIN

config SOC_FAMILY
	string
	default "gowin"

# source "soc/arm/gowin/*/Kconfig.soc"
rsource "./*/Kconfig.soc"

endif # SOC_FAMILY_GOWIN
```

## soc/arm/gowin/Kconfig.defconfig
```kconfig
#
# Copyright (c) 2023 YuLong Yao <feilongphone@gmail.com>
# SPDX-License-Identifier: Apache-2.0
#

# source "soc/arm/gowin/*/Kconfig.defconfig.series"
rsource "./*/Kconfig.defconfig.series"

if SOC_FAMILY_GOWIN

config SOC_SERIES
	default "gowin"

endif # SOC_FAMILY_GOWIN
```

## soc/arm/gowin/Kconfig.soc
```kconfig
#
# Copyright (c) 2023 YuLong Yao <feilongphone@gmail.com>
# SPDX-License-Identifier: Apache-2.0
#

# source "soc/arm/gowin/*/Kconfig.series"
rsource "./*/Kconfig.series"
```

## soc/arm/gowin/gwempu/Kconfig.defconfig.gwempu
```kconfig
# Copyright (c) 2023 YuLong Yao <feilongphone@gmail.com>
# SPDX-License-Identifier: Apache-2.0

config SOC
	default "gwempu"

config SYS_CLOCK_HW_CYCLES_PER_SEC
	default $(dt_node_int_prop_int,/cpus/cpu@0,clock-frequency)

config NUM_IRQS
	default 82
```

## soc/arm/gowin/gwempu/Kconfig.defconfig.series
```kconfig
# Copyright (c) 2023 YuLong Yao <feilongphone@gmail.com>
# SPDX-License-Identifier: Apache-2.0

if SOC_SERIES_GWEMPU

# source "soc/arm/gowin/empu/Kconfig.defconfig.gw*"
rsource "./Kconfig.defconfig.gw*"

config SOC_SERIES
	default "gwempu"

endif # SOC_SERIES_GD32A50X
```

## soc/arm/gowin/gwempu/Kconfig.series
```kconfig
# Copyright (c) 2023 YuLong Yao <feilongphone@gmail.com>
# SPDX-License-Identifier: Apache-2.0

config SOC_SERIES_GWEMPU
	bool "Gowin EMPU (Cortex-M3)"
	select ARM
	select CPU_CORTEX_M3
	select SOC_FAMILY_GOWIN
	select PLATFORM_SPECIFIC_INIT
	select GPIO_GOWIN_EMPU
	help
	  Enable support for Gowin EMPU series
```

## soc/arm/gowin/gwempu/Kconfig.soc
```kconfig
# Copyright (c) 2023 YuLong Yao <feilongphone@gmail.com>
# SPDX-License-Identifier: Apache-2.0

choice
	prompt "Gowin EMCU Selection"
	depends on SOC_SERIES_GWEMPU

	config SOC_GWEMPU
		bool "gwempu"

endchoice
```
