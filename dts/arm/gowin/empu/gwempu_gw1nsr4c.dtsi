/*
 * Copyright (c) 2023 YuLong Yao <feilongphone@gmail.com>
 *
 * SPDX-License-Identifier: Apache-2.0
 */

#include <mem.h>
#include <gowin/empu/gwempu.dtsi>

&flash0 {
	reg = <0x0 DT_SIZE_K(16)>;
};

&sram0 {
	reg = <0x20000000 DT_SIZE_K(4)>;
};
